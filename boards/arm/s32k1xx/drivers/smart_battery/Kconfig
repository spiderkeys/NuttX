## boards/arm/s32k1xx/drivers/smart_battery/Kconfig
```kconfig
#
# For a description of the syntax of this configuration file,
# see the file kconfig-language.txt in the NuttX tools repository.
#

config SBS_DRIVER
	bool "Simple SBS driver"
	default n
	depends on I2C_SLAVE
	---help---
		Simple smart battery driver, implementing a subset of the
		Smart Battery System (SBS) 1.1 specification for SMBus.
```

## boards/arm/s32k1xx/rddrone-bms772/Kconfig
```kconfig
#
# For a description of the syntax of this configuration file,
# see the file kconfig-language.txt in the NuttX tools repository.
#

if ARCH_BOARD_RDDRONE_BMS772

menuconfig RESET_CAUSE_PROC_FS
	bool "Enable reset cause as a proc fs"
	default n
	depends on FS_PROCFS
	select FS_PROCFS_REGISTER
	---help---
		"Enable reset cause as a proc fs as /proc/resetcause to get the reset cause"

menuconfig NRST_CHECK_PROC_FS
	bool "Enable nrst check as a proc fs"
	default y
	depends on FS_PROCFS
	select FS_PROCFS_REGISTER
	---help---
		"Enable nrst check as a proc fs as /proc/nrstcheck to check if the nrst connection is OK"

menu "PM configuration"
depends on PM
	menu "PM configuration PM_STANDBY mode"
		choice
			prompt "MCU power mode"
			default VLPR_STANDBY

			config RUN_STANDBY
				bool "RUN mode"
				---help---
					The MCU should be in RUN mode in the PM_STANDBY mode

			config VLPR_STANDBY
				bool "VLPR mode"
				---help---
					The MCU should be in VLPR (very low power run) mode in the PM_STANDBY mode

		endchoice # MCU power mode

		menuconfig PM_SPI_STANDBY
			bool "enable SPI for PM_STANDBY mode"
			default n
			depends on SPI
			---help---
				Enable PM configuration for SPI 

		if PM_SPI_STANDBY
			menuconfig PM_SPI0_STANDBY
				bool "Enable spi0 in PM_STANDBY"
				default n
				depends on S32K1XX_LPSPI0
				---help---
					Enable spi0 in power mode PM_STANDBY"
					
			menuconfig PM_SPI1_STANDBY
				bool "Enable spi1 in PM_STANDBY"
				default n
				depends on S32K1XX_LPSPI1
				---help---
					Enable spi1 in power mode PM_STANDBY"
		endif

		menuconfig PM_SERIAL_STANDBY
			bool "enable serial for PM_STANDBY mode"
			default n
			depends on SERIAL
			---help---
				Enable PM configuration for SERIAL 
				
		if PM_SERIAL_STANDBY
			menuconfig PM_CONSOLE_STANDBY
				bool "Enable the serial console in PM_STANDBY"
				default n
				depends on SERIAL_CONSOLE
				select PM_SERIAL0_STANDBY if LPUART0_SERIAL_CONSOLE
				select PM_SERIAL1_STANDBY if LPUART1_SERIAL_CONSOLE 
				select PM_SERIAL2_STANDBY if LPUART2_SERIAL_CONSOLE 
				---help---
					Enable the console in power mode PM_STANDBY"

			menuconfig PM_SERIAL0_STANDBY
				bool "Enable SERIAL0 in PM_STANDBY"
				default n
				depends on S32K1XX_LPUART0
				---help---
					Enable SERIAL0 in power mode PM_STANDBY"

			menuconfig PM_SERIAL1_STANDBY
				bool "Enable SERIAL1 in PM_STANDBY"
				default n
				depends on S32K1XX_LPUART1
				---help---
					Enable SERIAL1 in power mode PM_STANDBY"

			menuconfig PM_SERIAL2_STANDBY
				bool "Enable SERIAL2 in PM_STANDBY"
				default n
				depends on S32K1XX_LPUART2
				---help---
					Enable SERIAL2 in power mode PM_STANDBY"
		endif
	endmenu

	menu "PM configuration PM_SLEEP mode"
		choice
			prompt "MCU power mode"
			default VLPR_SLEEP

			config RUN_SLEEP
				bool "RUN mode"
				---help---
					The MCU should be in RUN mode in the PM_SLEEP mode

			config VLPR_SLEEP
				bool "VLPR mode"
				---help---
					The MCU should be in VLPR (very low power run) mode in the PM_SLEEP mode

		endchoice # MCU power mode

		menuconfig PM_SPI_SLEEP
			bool "enable SPI for PM_SLEEP mode"
			default n
			depends on SPI
			---help---
				Enable PM configuration for SPI 

		if PM_SPI_SLEEP
			menuconfig PM_SPI0_SLEEP
				bool "Enable spi0 in PM_SLEEP"
				default n
				depends on S32K1XX_LPSPI0
				---help---
					Enable spi0 in power mode PM_SLEEP"
			menuconfig PM_SPI1_SLEEP
				bool "Enable spi1 in PM_SLEEP"
				default n
				depends on S32K1XX_LPSPI1
				---help---
					Enable spi1 in power mode PM_SLEEP"
		endif

		menuconfig PM_SERIAL_SLEEP
			bool "enable serial for PM_SLEEP mode"
			default n
			depends on SERIAL
			---help---
				Enable PM configuration for SERIAL 
				
		if PM_SERIAL_SLEEP
			menuconfig PM_CONSOLE_SLEEP
				bool "Enable the serial console in PM_SLEEP"
				default n
				depends on SERIAL_CONSOLE
				select PM_SERIAL0_SLEEP if LPUART0_SERIAL_CONSOLE
				select PM_SERIAL1_SLEEP if LPUART1_SERIAL_CONSOLE 
				select PM_SERIAL2_SLEEP if LPUART2_SERIAL_CONSOLE 
				---help---
					Enable the console in power mode PM_SLEEP"

			menuconfig PM_SERIAL0_SLEEP
				bool "Enable SERIAL0 in PM_SLEEP"
				default n
				depends on S32K1XX_LPUART0

				---help---
					Enable SERIAL0 in power mode PM_SLEEP"

			menuconfig PM_SERIAL1_SLEEP
				bool "Enable SERIAL1 in PM_SLEEP"
				default n
				depends on S32K1XX_LPUART1
				---help---
					Enable SERIAL1 in power mode PM_SLEEP"

			menuconfig PM_SERIAL2_SLEEP
				bool "Enable SERIAL2 in PM_SLEEP"
				default n
				depends on S32K1XX_LPUART2
				---help---
					Enable SERIAL2 in power mode PM_SLEEP"
		endif
	endmenu
endmenu

endif # ARCH_BOARD_RDDRONE_BMS772
```

## sched/systemview/Kconfig
```kconfig
#
# For a description of the syntax of this configuration file,
# see the file kconfig-language.txt in the NuttX tools repository.
#

menuconfig SYSTEMVIEW_ENABLE
	bool "Enable SystemView Instrumentation"
	default n
    ---help---
        Enable instrumentation of the scheduler using SEGGER SystemView.

if SYSTEMVIEW_ENABLE
config SYSTEMVIEW_APP_NAME
    string "Application Name"
    default "NuttX start project"
config SYSTEMVIEW_DEVICE_NAME
    string "Device Name"
    default "Cortex-M3/M4/M7"
config SYSTEMVIEW_CPU_FREQ
    int "CPU Frequency [Hz]"
    default 168000000
config SYSTEMVIEW_TIMESTAMP_FREQ
    int "Timestamp Frequency [Hz]"
    default 168000000
config SYSTEMVIEW_RES_ID_BASE
    hex "Resource ID Base"
    default 0x00000000
config SYSTEMVIEW_RES_ID_SHIFT
    int "Resource ID Shift"
    default 0
config SYSTEMVIEW_START_ON_INIT
    bool "Start Recording on Init"
    default n
config SYSTEMVIEW_SYSDESC_0
    string "System Description 0"
    default "I#11=SVC,I#15=SysTick"
config SYSTEMVIEW_SYSDESC_1
    string "System Description 1"
config SYSTEMVIEW_SYSDESC_2
    string "System Description 2"
config SYSTEMVIEW_RECORD_API
    bool "Record APIs"
    default y
config SYSTEMVIEW_RECORD_ISR
    bool "Record Interrupts"
    default y
config SYSTEMVIEW_BUFFER_SIZE
    int "SystemView Buffer Size"
    default 8192
config SYSTEMVIEW_RTT_CHANNEL
    int "SystemView RTT Channel"
    default 1
config SYSTEMVIEW_USE_STATIC_BUFFER
    bool "Use static event buffer"
    default y
config SYSTEMVIEW_POST_MORTEM_MODE
    bool "Enable Post-Mortem Mode"
    default n
config SYSTEMVIEW_MAX_NOF_TASKS
    int "Maximum Number of Tasks"
    default 16
    ---help---
        Maximum number of Tasks to be recorded by Systemview.
        If more tasks are created, their information is not added to the list, i.e. not recorded.
        
endif # SYSTEMVIEW_ENABLE
```
